#include <p24fj32GA004.h>
#define FCY  16000000	//define instruction frequency here in Hz
#include <libpic30.h>	//Ultility library for pic24.
#include "GLCD_24.h"

//Define control pins here.
#define CHIPSELECT PORTBbits.RB9
#define RES PORTBbits.RB10
#define DATAMODE PORTBbits.RB11   //Register select pin, which is A0 on datasheet.

//Define pin direction.
#define TCHIPSELECT TRISBbits.TRISB9
#define TRES TRISBbits.TRISB10
#define TDATAMODE TRISBbits.TRISB11
#define SET_COLUMN_HIGH 0b00010000
#define SET_COLUMN_LOW 0b00000000
#define SET_PAGE 0b10110000

/*
//Just some symbols.
#define ARROW_RIGHT 0
#define ARROW_RIGHT_FILLED 1
#define ARROW_LEFT 2
#define ARROW_LEFT_FILLED 3
#define FILL 4
*/

//Variable for the current position of the cursor in a 4*16 coordinate system, left-upper corner represents x=0,y=0.

unsigned char X = 0;
unsigned char Y = 0;


const unsigned char SYMBOLS[] = {
 0xFE, 0xFF, 0x04, 0x40, 0x08, 0x20, 0x10, 0x10, 0x20, 0x08, 0x40, 0x04, 0x80, 0x02, 0x00, 0x01,  // Code for char  
 0xFE, 0xFF, 0xFC, 0x7F, 0xF8, 0x3F, 0xF0, 0x1F, 0xE0, 0x0F, 0xC0, 0x07, 0x80, 0x03, 0x00, 0x01,  // Code for char 
 0x00, 0x01, 0x80, 0x02, 0x40, 0x04, 0x20, 0x08, 0x10, 0x10, 0x08, 0x20, 0x04, 0x40, 0xFE, 0xFF,  // Code for char 
 0x00, 0x01, 0x80, 0x03, 0xC0, 0x07, 0xE0, 0x0F, 0xF0, 0x1F, 0xF8, 0x3F, 0xFC, 0x7F, 0xFE, 0xFF,  // Code for char 
 0xFF, 0xFF, 0xFF, 0xFF, 0xFF, 0xFF, 0xFF, 0xFF,  0xFF, 0xFF, 0xFF, 0xFF, 0xFF, 0xFF, 0xFF, 0xFF  // Code for char 
        };


const unsigned char CHAR_TABLE[] = {
         0x00, 0x00, 0x00, 0x00, 0x00, 0x00, 0x00, 0x00, 0x00, 0x00, 0x00, 0x00, 0x00, 0x00, 0x00, 0x00,  // Code for char  
         0x00, 0x00, 0x00, 0x00, 0x00, 0x00, 0xFC, 0x37, 0xFC, 0x31, 0x00, 0x00, 0x00, 0x00, 0x00, 0x00,  // Code for char !
         0x00, 0x00, 0x00, 0x00, 0x38, 0x00, 0x08, 0x00, 0x08, 0x00, 0x38, 0x00, 0x00, 0x00, 0x00, 0x00,  // Code for char "
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         0xF0, 0x1F, 0x10, 0x10, 0xF0, 0x1F, 0x00, 0x00, 0x00, 0x00, 0x00, 0x00, 0x00, 0x00, 0x00, 0x00   // Code for char 
        };

void IO_Init()
{
	//Set all control pins to be output.
	TCHIPSELECT = 0;
    TRES = 0;
	TDATAMODE = 0;

	CHIPSELECT = 1;

}


void SPI_Init()
{
	//SPI pin mapping.
 	RPOR6bits.RP12R = 8;		//SCK1 >> RP12
	RPOR6bits.RP13R = 7;		//SDO1 >> RP13

	SPI1STATbits.SPISIDL = 1;
	SPI1STATbits.SPIROV = 0;

	SPI1CON1bits.DISSDO = 0;	//SDO1 controlled by SPI module
	SPI1CON1bits.MODE16 = 0;	//byte mode
	SPI1CON1bits.SMP = 0;		//sample data at middle of data output time
	SPI1CON1bits.CKE = 0;		//output data changes from high to low
	SPI1CON1bits.CKP = 0;		//idle > low, active > high
	SPI1CON1bits.MSTEN = 1;		// master mode
	SPI1CON1bits.SPRE2 = 1;		// 8:1 secondary prescaler.
	SPI1CON1bits.SPRE1 = 1;
	SPI1CON1bits.SPRE0 = 0;	
	SPI1CON1bits.PPRE1 = 1;		// 64:1 primary prescaler.
	SPI1CON1bits.PPRE0 = 1;
	
	//The minimun clock cycle for serial interface is 125ns. Here I set it to be 32us.
	//You can speed up the LCD by making the clock cycle shorter.
	
	
	SPI1STATbits.SPIEN = 1;

}


void GLCD_Init()
{	
	IO_Init();
	SPI_Init();
	
	RES = 1;
	RES = 0;					//reset
	__delay_ms(5);
	RES = 1;
	__delay_ms(5);

	GLCD_Command(0b10100010);	// 1/9 bias	
	GLCD_Command(0b10100000);	// ADC = normal
	
	GLCD_Command(0b11001000);	// SHL = reverse 
	GLCD_Command(0b01000000);	// line 0

	GLCD_Command(0b00101100);	// voltage foller off, regulator off, converter on
	__delay_ms(5)
	GLCD_Command(0b00101110);	// voltage foller off, regulator on, converter on
	__delay_ms(5);

	GLCD_Command(0b00101111);	// voltage foller on, regulator on, converter on
	__delay_ms(5);

	GLCD_Command(0b00100110);	// set resistor ratio

	GLCD_Command(0b10000001);	// contrast 50%
	GLCD_Command(0b00011010);	// contrast 50%

	GLCD_Command(0b10101110);	// display off
	GLCD_Command(0b10101111);	// display on
	GLCD_Command(0b10110000);	// page 0 

	GLCD_Command(0b00010000);	// column 0
	GLCD_Command(0b00000000);	// column 0

	GLCD_Command(0b10100100);	// display all pts off
	GLCD_Command(0b11100000);	// turn on column self increment

	GLCD_Clear();
	
}


void GLCD_Out(unsigned char x, unsigned char y,unsigned char * out)
{
	X = x;
	Y = y;

	while(*out != '\0')
	{	
		GLCD_Char(X,Y,*out);
		out++;
		Y++;
		
		if(Y == 16)
		{
			Y = 0;
			X++;
			X&=3;
	
		}

	}

}

void GLCD_SETCURSOR(unsigned char x, unsigned char y)
{
	X = x;
	Y = y;

}


void GLCD_Out_Inc(unsigned char * out)
{

	while(*out != '\0')
	{	
		GLCD_Char(X,Y,*out);
		out++;
		Y++;
		
		if(Y == 16)
		{
			Y = 0;
			X++;
			X&=3;
	
		}

	}

}

void GLCD_Char(unsigned char x,unsigned char y,unsigned char out)		// output a character @ x(row) , y(column) x max = 3, y max = 15
																		// maximun char: 4*16
																		// one char takes 8*16 pixelcs
{

	unsigned char p, c,i;
	X = x;
	Y = y;

	for( c = 0 ; c < 8 ; c++)
	{

		for( p = 0 ; p < 2 ; p ++ ) 
		{
			GLCD_Command(SET_PAGE | ((x<<1) + p));
			GLCD_Command(SET_COLUMN_LOW | (((y<<3) + c) & 0x0F ));
			GLCD_Command(SET_COLUMN_HIGH | (((y<<3)+  c )>> 4));
			GLCD_Data(CHAR_TABLE[(out - 32)*16 + c*2 +  p]);

		}


	}

}

void GLCD_Char_Inc(unsigned char out)
{

	GLCD_Char(X,Y,out);
	Y++;
	
	if(Y == 16)
	{
		Y = 0;
		X++;
		X&=3;

	}
	

}

void GLCD_Sym(unsigned char x,unsigned char y,unsigned char out)		// row X , column Y
{
	X = x;
	Y = y;

	unsigned char p, c,i;
	X = x;
	Y = y;

	for( c = 0 ; c < 8 ; c++)
	{

		for( p = 0 ; p < 2 ; p ++ ) 
		{
			GLCD_Command(SET_PAGE | ((x<<1) + p));
			GLCD_Command(SET_COLUMN_LOW | (((y<<3) + c) & 0x0F ));
			GLCD_Command(SET_COLUMN_HIGH | (((y<<3)+  c )>> 4));
			GLCD_Data(SYMBOLS[out*16 + c*2 +  p]);

		}

	}

}

void GLCD_Sym_Inc(unsigned char out)
{

	GLCD_Sym(X,Y,out);
	Y++;
	
	if(Y == 16)
	{
		Y = 0;
		X++;
		X&=3;

	}
	

}


void GLCD_Data( unsigned char out)
{


	DATAMODE = 1;
	
	//This can be way faster.
	//I set the delay just in case.
	__delay_us(2);
	CHIPSELECT = 0;
		//There should be at least 75ns of delay here. But since I am running at a slow clock, the delay is not necessary.
	SPI_Out(out);
	CHIPSELECT = 1;

}

void GLCD_Command( unsigned char out)
{

	DATAMODE = 0;
	
	//This can be way faster.
	//I set the delay just in case.
	__delay_us(2);

	CHIPSELECT = 0;
	//There should be at least 75ns of delay here. But since I am running at a slow clock, the delay is not necessary.
	SPI_Out(out);
	CHIPSELECT = 1;
}

void GLCD_Clear(void)
{
	unsigned char page,column;

	for( page = 0 ; page < 8 ; page ++ ) 
	{
		GLCD_Command(SET_PAGE | page);
		GLCD_Command(SET_COLUMN_HIGH);
		GLCD_Command(SET_COLUMN_LOW);	
		for( column = 0 ; column < 128 ; column++)
		{
			GLCD_Data(0);
		}

	}
}

void GLCD_Draw_Bitmap(unsigned char *DisplayData)   // DisplayData should be 1024 bytes
{
    unsigned i, j;

    for(i=0;i<8;i++)
        {
        GLCD_Command(0xb0 | i);    // select page 0~7
        GLCD_Command(0x10);        // column 0 
        GLCD_Command(0x00);        // column 0 

        for(j=0;j<128;j++)
        	{
			GLCD_Data(*DisplayData);
			DisplayData++;
            }
        }
}

void GLCD_ClearRow(unsigned char x)
{
	GLCD_Out(x,0,"                ");
}

void SPI_Out( unsigned char out )
{
	unsigned char temp = 0;

	IFS0bits.SPI1IF = 0;
	SPI1BUF = out;
	while ( !IFS0bits.SPI1IF  ) ;
	temp = SPI1BUF;

				
}